/*###ICF### Section handled by ICF editor, don't touch! ****/
/*-Editor annotation file-*/
/* IcfEditorFile="$TOOLKIT_DIR$\config\ide\IcfEditor\a_v1_0.xml" */
/*-Specials-*/
define symbol __ICFEDIT_intvec_start__ = 0x80000000;
/*-Memory Regions-*/
define symbol __ICFEDIT_region_ROM_start__ = 0x80001000;
define symbol __ICFEDIT_region_ROM_end__   = 0x807FFFFF;
define symbol __ICFEDIT_region_RAM_start__ = 0x80800000;
define symbol __ICFEDIT_region_RAM_end__   = 0x80FFFFFF;
/*-Sizes-*/
define symbol __ICFEDIT_size_cstack__   = 0x3000;
define symbol __ICFEDIT_size_svcstack__ = 0x100;
define symbol __ICFEDIT_size_irqstack__ = 0xB00;
define symbol __ICFEDIT_size_fiqstack__ = 0x100;
define symbol __ICFEDIT_size_undstack__ = 0x100;
define symbol __ICFEDIT_size_abtstack__ = 0x100;
define symbol __ICFEDIT_size_heap__     = 0;
/**** End of ICF editor section. ###ICF###*/


define memory mem with size = 4G;
define region ROM_region   = mem:[from __ICFEDIT_region_ROM_start__   to __ICFEDIT_region_ROM_end__];
define region RAM_region   = mem:[from __ICFEDIT_region_RAM_start__   to __ICFEDIT_region_RAM_end__];

define block CSTACK    with alignment = 0x100, size = __ICFEDIT_size_cstack__   { };
define block SVC_STACK with alignment = 0x100, size = __ICFEDIT_size_svcstack__ { };
define block IRQ_STACK with alignment = 0x800, size = __ICFEDIT_size_irqstack__ { };
define block FIQ_STACK with alignment = 0x100, size = __ICFEDIT_size_fiqstack__ { };
define block UND_STACK with alignment = 0x100, size = __ICFEDIT_size_undstack__ { };
define block ABT_STACK with alignment = 0x100, size = __ICFEDIT_size_abtstack__ { };
define block ROMEND    with alignment = 8 { };

initialize by copy { readwrite };
do not initialize  { section .noinit };

place at address mem:__ICFEDIT_intvec_start__ { readonly section .intvec };

place at start of ROM_region { block RomTop with fixed order {readonly, block ROMEND}};
place at start of RAM_region { block RamTop with fixed order {readwrite}};
place at end of RAM_region { block RamBottom with fixed order {
                        section MPLMEM, section STKMEM, section SYSMEM,
                        block CSTACK, block IRQ_STACK, block SVC_STACK, block FIQ_STACK,
                        block UND_STACK, block ABT_STACK, section SYS}};
